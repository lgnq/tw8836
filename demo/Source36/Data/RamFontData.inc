//
// RAM FONT DATA
//

/* <FONT DATA> */
code unsigned char RAMFONTDATA[][27] =
{
    /*0x00(  0)*/ {0x00,0x00,0x00,0x00,0x00,0x00,0x00,0x66,0x00,0x00,0x24,0x00,0x00,0x00,0x00,0x00,0x00,0x00,0x00,0x00,0x00,0x00,0x00,0x00,0x00,0x00,0x00},
    /*0x01(  1)*/ {0x00,0x00,0x00,0x00,0x60,0x00,0x00,0x06,0x00,0x00,0x60,0x00,0x00,0xF6,0x00,0x00,0xFF,0x00,0x00,0xFF,0x00,0x00,0x06,0x00,0x00,0x00,0x00},
    /*0x02(  2)*/ {0x00,0x00,0x00,0x00,0x00,0x00,0x00,0x66,0x00,0x00,0x46,0x00,0x00,0x00,0x00,0x00,0x00,0x00,0x00,0x00,0x00,0x00,0x00,0x00,0x00,0x00,0x00},
    /*0x03(  3)*/ {0x00,0x00,0x00,0x00,0x00,0x00,0x00,0x00,0x00,0x00,0x00,0x00,0xFF,0xFF,0xFF,0x00,0x00,0x00,0x00,0x00,0x00,0x00,0x00,0x00,0x00,0x00,0x00},
    /*0x04(  4)*/ {0x00,0xF0,0x00,0x21,0x60,0x48,0x44,0x89,0x22,0x44,0x98,0x22,0x12,0x06,0x84,0x00,0x0F,0x00,0x00,0x00,0x00,0x00,0x00,0x00,0x00,0x00,0x00},
    /*0x05(  5)*/ {0x30,0xA0,0x20,0x34,0x23,0xA6,0x70,0x2A,0x22,0x00,0x00,0x00,0x00,0x00,0x00,0x00,0x00,0x00,0x00,0x00,0x00,0x00,0x00,0x00,0x00,0x00,0x00},
    /*0x06(  6)*/ {0x00,0x00,0x00,0x00,0x00,0x00,0x00,0x00,0x00,0x00,0x00,0x00,0x00,0x00,0x00,0x00,0xF6,0x00,0x00,0x6F,0x00,0x00,0x00,0x00,0x00,0x00,0x00},
    /*0x07(  7)*/ {0x00,0x00,0x00,0x00,0xF0,0x00,0x31,0x9F,0xC8,0x33,0x00,0x0C,0x33,0x00,0x00,0x33,0x00,0xC0,0x13,0xF9,0x8C,0x00,0x2F,0x00,0x00,0x61,0x00},
    /*0x08(  8)*/ {0x00,0x00,0x00,0x00,0x00,0x00,0x00,0x60,0x60,0x10,0x9C,0x8C,0x63,0x63,0x00,0x36,0x36,0x00,0x01,0xC9,0xC8,0x00,0x06,0x06,0x00,0x00,0x00},
    /*0x09(  9)*/ {0x00,0x00,0x00,0x00,0x00,0x00,0x60,0x60,0x00,0x13,0x93,0x80,0x00,0x6C,0x6C,0x00,0xC6,0xC6,0x31,0x39,0x08,0x06,0x06,0x00,0x00,0x00,0x00},
    /*0x0A( 10)*/ {0x00,0x00,0x00,0x00,0x63,0x00,0x00,0x44,0x00,0x00,0xC4,0x00,0x11,0x88,0x00,0x00,0x4C,0x00,0x00,0x44,0x00,0x00,0x36,0x00,0x00,0x00,0x00},
    /*0x0B( 11)*/ {0x00,0x00,0x00,0x00,0x6C,0x00,0x00,0x22,0x00,0x00,0x32,0x00,0x00,0x11,0x88,0x00,0x23,0x00,0x00,0x22,0x00,0x00,0xC6,0x00,0x00,0x00,0x00},
    /*0x0C( 12)*/ {0x00,0x00,0x00,0x00,0x60,0x00,0x10,0x9F,0x80,0x00,0x00,0x00,0x00,0x00,0x00,0x00,0x00,0x00,0x00,0x00,0x00,0x00,0x00,0x00,0x00,0x00,0x00},
    /*0x0D( 13)*/ {0x00,0x00,0x00,0x00,0x00,0x00,0x00,0x00,0x00,0x00,0x00,0x00,0x00,0x00,0x00,0x00,0x00,0x00,0x00,0x00,0x00,0x77,0xFF,0xEE,0x00,0x00,0x00},
    /*0x0E( 14)*/ {0x00,0x00,0x00,0x00,0x66,0x00,0x00,0x66,0x00,0x00,0x66,0x00,0x00,0x66,0x00,0x00,0x66,0x00,0x00,0x66,0x00,0x00,0x66,0x00,0x00,0x00,0x00},
    /*0x0F( 15)*/ {0x00,0x00,0x00,0x10,0x9F,0x80,0x11,0x99,0x88,0x11,0xFF,0x00,0x11,0x99,0x88,0x11,0x99,0x88,0x11,0x8F,0x00,0x03,0x08,0x00,0x00,0x00,0x00},
    /*0x10( 16)*/ {0x00,0x00,0x00,0x33,0xF0,0xCC,0x11,0x09,0x88,0x11,0x90,0x88,0x33,0x0F,0xCC,0x00,0x00,0x00,0x00,0x00,0x00,0x00,0x00,0x00,0x00,0x00,0x00},
    /*0x11( 17)*/ {0x00,0x66,0x00,0x00,0x66,0x00,0x00,0x66,0x00,0x00,0x66,0x00,0x00,0x66,0x00,0x00,0x66,0x00,0x00,0x66,0x00,0x00,0x66,0x00,0x00,0x66,0x00},
    /*0x12( 18)*/ {0x00,0x00,0x00,0x00,0x00,0x00,0x00,0x00,0x00,0x00,0xF0,0x00,0x31,0x9F,0xC8,0x33,0x63,0xCC,0x33,0x9C,0xCC,0x01,0xFF,0x08,0x00,0x00,0x00},
    /*0x13( 19)*/ {0x00,0x00,0x00,0x00,0x00,0x00,0x00,0x00,0x00,0x00,0x00,0x00,0x00,0x77,0xFF,0x00,0x66,0x00,0x00,0x66,0x00,0x00,0x66,0x00,0x00,0x66,0x00},
    /*0x14( 20)*/ {0x00,0x00,0x00,0x00,0x00,0x00,0x00,0x00,0x00,0x00,0x00,0x00,0xFF,0xEE,0x00,0x00,0x66,0x00,0x00,0x66,0x00,0x00,0x66,0x00,0x00,0x66,0x00},
    /*0x15( 21)*/ {0x00,0x66,0x00,0x00,0x66,0x00,0x00,0x66,0x00,0x00,0x66,0x00,0x00,0x77,0xFF,0x00,0x00,0x00,0x00,0x00,0x00,0x00,0x00,0x00,0x00,0x00,0x00},
    /*0x16( 22)*/ {0x00,0x66,0x00,0x00,0x66,0x00,0x00,0x66,0x00,0x00,0x66,0x00,0xFF,0xEE,0x00,0x00,0x00,0x00,0x00,0x00,0x00,0x00,0x00,0x00,0x00,0x00,0x00},
    /*0x17( 23)*/ {0x00,0x00,0x00,0x77,0xFF,0xEE,0x77,0xFF,0xEE,0x77,0xFF,0xEE,0x77,0xFF,0xEE,0x77,0xFF,0xEE,0x77,0xFF,0xEE,0x77,0xFF,0xEE,0x00,0x00,0x00},
    /*0x18( 24)*/ {0x70,0xF0,0xF0,0x66,0xE0,0x00,0x66,0xAC,0x00,0x66,0x00,0x8F,0x66,0x00,0x88,0x66,0x00,0xF8,0x66,0xCA,0x00,0x66,0x0E,0x00,0x07,0x0F,0x0F},
    /*0x19( 25)*/ {0xF0,0xF0,0xE0,0x00,0x70,0x66,0x00,0x53,0x66,0x1F,0x00,0x66,0x11,0x00,0x66,0xF1,0x00,0x66,0x00,0x35,0x66,0x00,0x07,0x66,0x0F,0x0F,0x0E},
    /*0x1A( 26)*/ {0x30,0xF0,0xF0,0x66,0x00,0x00,0x66,0x10,0xF0,0x66,0x11,0x70,0x66,0x11,0x70,0x66,0x11,0xF0,0x66,0x00,0x00,0x66,0x00,0x00,0x03,0x0F,0x0F},
    /*0x1B( 27)*/ {0xF0,0xF0,0xC0,0x00,0x00,0x66,0xF0,0x80,0x66,0xE0,0x88,0x66,0xE0,0x88,0x66,0xF0,0x88,0x66,0x00,0x00,0x66,0x00,0x00,0x66,0x0F,0x0F,0x0C},
    /*0x1C( 28)*/ {0x30,0xF0,0xF0,0x66,0xF0,0xD1,0x66,0xF0,0xD1,0x76,0xF0,0xF1,0x66,0x00,0x00,0x66,0x00,0x00,0x66,0x00,0x00,0x66,0x00,0x00,0x03,0x0F,0x0F},
    /*0x1D( 29)*/ {0xF0,0xF0,0xC0,0x00,0x00,0x66,0x00,0x00,0x66,0x00,0x00,0x66,0x00,0x00,0x66,0x00,0x00,0x66,0x00,0x00,0x66,0x00,0x00,0x66,0x0F,0x0F,0x0C},
    /*0x1E( 30)*/ {0x30,0xF0,0xF0,0x66,0x00,0x00,0x66,0x00,0x00,0x66,0x00,0x00,0x66,0x00,0x00,0x67,0x0F,0x1F,0x66,0x0F,0x1D,0x66,0x0F,0x1D,0x03,0x0F,0x0F},
    /*0x1F( 31)*/ {0x30,0xF0,0xF0,0x66,0x00,0x00,0x66,0x00,0x00,0x66,0x00,0x00,0x66,0x00,0x00,0x66,0x00,0x00,0x66,0x00,0x00,0x66,0x00,0x00,0x03,0x0F,0x0F},
    /*0x20( 32)*/ {0xF0,0xF0,0xC0,0x00,0x00,0x66,0x00,0x00,0x66,0x00,0x00,0x66,0x00,0x00,0x66,0x8F,0x0F,0x6E,0x8B,0x0F,0x66,0x8B,0x0F,0x66,0x0F,0x0F,0x0C},
    /*0x21( 33)*/ {0xF0,0xF0,0xC0,0xB8,0xF0,0x66,0xB8,0xF0,0x66,0xF8,0xF0,0xE6,0x00,0x00,0x66,0x00,0x00,0x66,0x00,0x00,0x66,0x00,0x00,0x66,0x0F,0x0F,0x0C},
    /*0x22( 34)*/ {0x00,0x00,0x00,0x07,0x6E,0x66,0x00,0x66,0x76,0x10,0x8C,0x66,0x07,0x00,0x66,0x00,0x00,0x00,0x33,0x00,0x00,0x33,0xF0,0xE0,0x00,0x00,0x00},
    /*0x23( 35)*/ {0x00,0x00,0x00,0x03,0x0F,0x6E,0x00,0x00,0x66,0x00,0x00,0x06,0x07,0x6F,0x0F,0x30,0xF6,0xE0,0x00,0x00,0x66,0x00,0x00,0x46,0x00,0x00,0x00},
    /*0x24( 36)*/ {0x00,0x00,0x00,0x70,0xE0,0x66,0x00,0x66,0x66,0x00,0x46,0x66,0x00,0x8C,0x66,0x31,0x08,0x66,0x06,0x00,0x66,0x00,0x00,0x66,0x00,0x00,0x00},
    /*0x25( 37)*/ {0x00,0x00,0x00,0x03,0x0F,0xCC,0x00,0x00,0xCC,0x00,0x00,0x0C,0x17,0x9F,0x8E,0x11,0x99,0x88,0x31,0x09,0x08,0x33,0xF0,0xC0,0x00,0x00,0x00},
    /*0x26( 38)*/ {0x00,0x00,0x00,0x07,0x6E,0x66,0x00,0x46,0x76,0x10,0x8C,0x66,0x07,0x00,0x66,0x30,0xF0,0xE0,0x33,0x00,0x66,0x33,0xF0,0xE6,0x00,0x00,0x00},
    /*0x27( 39)*/ {0x00,0x00,0x00,0x07,0xCF,0x66,0x00,0xCC,0x66,0x31,0x3E,0x66,0x46,0x01,0xEE,0x30,0xF0,0xE0,0x33,0x00,0x66,0x33,0xF0,0xE6,0x00,0x00,0x00},
    /*0x28( 40)*/ {0x00,0x00,0x00,0x07,0x6E,0x66,0x00,0xC6,0x6E,0x10,0x8C,0x6E,0x07,0x00,0x06,0x00,0x63,0xC8,0x00,0xCC,0x66,0x00,0x36,0x8C,0x00,0x00,0x00},
    /*0x29( 41)*/ {0x00,0x00,0x00,0x03,0x0F,0xCC,0x00,0x00,0xCC,0x00,0x00,0xCC,0x00,0xC0,0xCC,0x00,0xCC,0x00,0x70,0xFC,0xE0,0x00,0x00,0x00,0x00,0x00,0x00},
    /*0x2A( 42)*/ {0x00,0x00,0x00,0x30,0x00,0x66,0x33,0x00,0x66,0x33,0x00,0x76,0x33,0x00,0x66,0x03,0x0F,0x66,0x00,0x00,0x66,0x00,0x00,0x66,0x00,0x00,0x00},
    /*0x2B( 43)*/ {0x00,0x00,0x00,0x11,0x88,0x00,0x11,0x88,0x00,0x01,0x0F,0x0C,0x70,0xF6,0xE0,0x10,0xF0,0xC0,0x00,0x00,0xCC,0x00,0x00,0x8C,0x00,0x00,0x00},
    /*0x2C( 44)*/ {0x00,0x00,0x00,0x33,0x00,0x00,0x33,0x00,0x00,0x03,0x0F,0x0C,0xF0,0xF6,0xE0,0x10,0xF0,0x80,0x33,0x00,0xCC,0x13,0xF0,0x8C,0x00,0x00,0x00},
    /*0x2D( 45)*/ {0x00,0x00,0x00,0x66,0x00,0x66,0x66,0x01,0x6E,0x76,0xF0,0x66,0x30,0xF0,0xE0,0x30,0xF0,0xE6,0x33,0x00,0x00,0x33,0xF0,0xE0,0x00,0x00,0x00},
    /*0x2E( 46)*/ {0x00,0x00,0x00,0x33,0x00,0x00,0x33,0x00,0x00,0x03,0x0F,0x0C,0x07,0x0F,0x0E,0x10,0xF0,0x80,0x33,0x09,0xCC,0x13,0xF9,0x8C,0x00,0x00,0x00},
    /*0x2F( 47)*/ {0x00,0x00,0x00,0x33,0x00,0x00,0x33,0x00,0x00,0x03,0x0F,0x0C,0x0F,0x0F,0x0F,0x30,0x00,0x00,0x33,0x00,0x00,0x33,0xF0,0xC0,0x00,0x00,0x00},
    /*0x30( 48)*/ {0x00,0x00,0x00,0x17,0xBF,0x66,0x11,0xBB,0x66,0x11,0xBB,0x6E,0x31,0x6B,0x66,0x63,0xC6,0x66,0x00,0x00,0x66,0x00,0x00,0x66,0x00,0x00,0x00},
    /*0x31( 49)*/ {0x00,0x00,0x00,0x07,0x6E,0x66,0x00,0xC6,0xE6,0x10,0x8C,0x66,0x63,0x00,0x66,0x30,0xF0,0xE0,0x33,0x00,0x66,0x33,0xF0,0xE6,0x00,0x00,0x00},
    /*0x32( 50)*/ {0x00,0x00,0x00,0x67,0x0E,0xCC,0x66,0x00,0xCC,0x66,0x00,0xFC,0x66,0x00,0xCC,0x07,0x0E,0xCC,0x00,0x00,0xCC,0x00,0x00,0xCC,0x00,0x00,0x00},
    /*0x33( 51)*/ {0x00,0x00,0x00,0x33,0x0F,0x0C,0x33,0x00,0x00,0x33,0x00,0x00,0x33,0xF0,0xC0,0x00,0x60,0x00,0xF0,0xF6,0xF0,0x00,0x00,0x00,0x00,0x00,0x00},
    /*0x34( 52)*/ {0x00,0x00,0x00,0x33,0x0F,0x0C,0x33,0x00,0x00,0x33,0x00,0x00,0x33,0xF0,0xC0,0x00,0x00,0x00,0x70,0xF0,0xE0,0x00,0x00,0x00,0x00,0x00,0x00},
    /*0x35( 53)*/ {0x00,0x00,0x00,0x33,0x0F,0x08,0x33,0x00,0x00,0x03,0x6F,0x08,0x0F,0x0F,0x0E,0x10,0x9F,0x80,0x33,0x00,0xCC,0x01,0xF9,0x08,0x00,0x00,0x00},
    /*0x36( 54)*/ {0x00,0x00,0x00,0x07,0x6E,0x66,0x70,0xE6,0x6E,0x66,0x00,0x6E,0x07,0x0F,0x06,0x00,0xF0,0xE0,0x00,0x00,0x66,0x00,0x00,0x46,0x00,0x00,0x00},
    /*0x37( 55)*/ {0x00,0x00,0x00,0x07,0x6E,0xCC,0x70,0xE6,0xCF,0x66,0x00,0xFC,0x07,0x0E,0x0C,0x10,0x9F,0x80,0x33,0x00,0xCC,0x01,0xF9,0x08,0x00,0x00,0x00},
    /*0x38( 56)*/ {0x00,0x00,0x00,0x03,0x0F,0xCC,0x33,0x0F,0x0C,0x03,0x0F,0x0C,0x07,0x0F,0x0E,0x03,0x0F,0xCC,0x33,0x0F,0x0C,0x33,0xF0,0xE0,0x00,0x00,0x00},
    /*0x39( 57)*/ {0x00,0x00,0x00,0x67,0x6E,0x66,0x66,0x66,0x6E,0x66,0x66,0x6E,0x07,0x0E,0x06,0x00,0xC7,0xC8,0x11,0x88,0x66,0x00,0x7C,0x8C,0x00,0x00,0x00},
    /*0x3A( 58)*/ {0x00,0x00,0x00,0x33,0x0F,0xCC,0x33,0x00,0xCC,0x33,0x00,0xCC,0x33,0xF0,0xCC,0x00,0x60,0x00,0x70,0xF6,0xE0,0x00,0x00,0x00,0x00,0x00,0x00},
    /*0x3B( 59)*/ {0x00,0x00,0x00,0x67,0x6E,0x66,0x66,0x66,0x6E,0x66,0x66,0xE6,0x76,0xE6,0x66,0x00,0x00,0x06,0x00,0xCC,0x00,0x00,0xFC,0xE0,0x00,0x00,0x00},
    /*0x3C( 60)*/ {0x00,0x00,0x00,0x67,0x3F,0x66,0x66,0x33,0x66,0x66,0x33,0x66,0x76,0xF3,0x66,0x00,0x00,0x66,0x00,0x00,0x66,0x00,0x00,0x66,0x00,0x00,0x00},
    /*0x3D( 61)*/ {0x00,0x00,0x00,0x67,0x6E,0x66,0x66,0x66,0x66,0x76,0xE6,0x66,0x00,0x00,0x06,0x03,0x0F,0x6E,0x33,0x0F,0x0E,0x33,0xF0,0xE0,0x00,0x00,0x00},
    /*0x3E( 62)*/ {0x00,0x00,0x00,0x66,0x66,0x66,0x76,0xF6,0xE6,0x66,0x66,0x66,0x76,0xE6,0x66,0x00,0x00,0x00,0x33,0x00,0x00,0x33,0xF0,0xE0,0x00,0x00,0x00},
    /*0x3F( 63)*/ {0x00,0x00,0x00,0x66,0x66,0x66,0x76,0xE7,0x6E,0x66,0x76,0xE6,0x76,0xE6,0x66,0x00,0x00,0x00,0x33,0x00,0x00,0x33,0xF0,0xE0,0x00,0x00,0x00},
    /*0x40( 64)*/ {0x00,0x00,0x00,0x66,0x66,0xCC,0x67,0x6E,0xEC,0x66,0x66,0xCC,0x07,0x0E,0x0C,0x17,0x8B,0xCC,0x67,0x08,0xCC,0x76,0x80,0x8C,0x00,0x00,0x00},
    /*0x41( 65)*/ {0x00,0x00,0x00,0x66,0x66,0x66,0x76,0xE6,0x66,0x66,0x66,0x66,0x76,0xE6,0x66,0x00,0x00,0x66,0x00,0x00,0x66,0x00,0x00,0x66,0x00,0x00,0x00},
    /*0x42( 66)*/ {0x00,0x00,0x00,0x11,0x88,0x66,0x31,0xC8,0x66,0x63,0x6C,0x66,0xCE,0x37,0x66,0x00,0x00,0x66,0x00,0x00,0x66,0x00,0x00,0x66,0x00,0x00,0x00},
    /*0x43( 67)*/ {0x00,0x00,0x00,0x11,0x88,0x66,0x33,0xCC,0x66,0x66,0x66,0x66,0x0C,0x03,0x06,0x10,0x80,0x00,0x11,0x88,0x00,0x11,0xF8,0xE0,0x00,0x00,0x00},
    /*0x44( 68)*/ {0x00,0x00,0x00,0x11,0x88,0x66,0x33,0xCD,0x6E,0x66,0x66,0x66,0x04,0x02,0x06,0x10,0xF0,0xE0,0x10,0xF0,0xE6,0x11,0xF8,0xE0,0x00,0x00,0x00},
    /*0x45( 69)*/ {0x00,0x00,0x00,0x00,0x66,0x00,0x00,0xF6,0x00,0x31,0x09,0xC8,0x06,0x00,0x06,0x07,0x6F,0x0E,0x00,0x66,0x00,0x00,0x66,0x00,0x00,0x00,0x00},
    /*0x46( 70)*/ {0x00,0x00,0x00,0x11,0x88,0x66,0x31,0xD8,0xE6,0x63,0x6C,0x66,0x46,0x26,0x66,0x00,0x00,0x06,0x33,0x00,0x00,0x33,0xF0,0xE0,0x00,0x00,0x00},
    /*0x47( 71)*/ {0x00,0x00,0x00,0x10,0x80,0x66,0x11,0x88,0x66,0x11,0x88,0x76,0x33,0xCC,0x66,0xC6,0x36,0x66,0x00,0x00,0x66,0x00,0x00,0x66,0x00,0x00,0x00},
    /*0x48( 72)*/ {0x00,0x00,0x00,0x00,0xCC,0x66,0x11,0xEE,0x76,0x33,0x33,0xE6,0x06,0x01,0x0E,0x00,0xC7,0xC8,0x11,0x88,0x66,0x00,0x7C,0x8C,0x00,0x00,0x00},
    /*0x49( 73)*/ {0x00,0x00,0x00,0x10,0x91,0xBB,0x11,0x99,0xBB,0x11,0x9F,0xBB,0x31,0xD9,0xBB,0xC6,0x37,0xBB,0x00,0x11,0xBB,0x00,0x11,0xBB,0x00,0x00,0x00},
    /*0x4A( 74)*/ {0x00,0x00,0x00,0x11,0x99,0xBB,0x31,0xD9,0xFB,0x63,0x7D,0xBB,0x04,0x03,0x0B,0x00,0x0F,0x3F,0x00,0x00,0x33,0x00,0x00,0x23,0x00,0x00,0x00},
    /*0x4B( 75)*/ {0x00,0x00,0x00,0x00,0xCC,0x66,0x11,0xEE,0x76,0x33,0x33,0xE6,0x06,0x01,0x0E,0x00,0xC7,0xC8,0x11,0x88,0x66,0x00,0x7C,0x8C,0x00,0x00,0x00},
    /*0x4C( 76)*/ {0x00,0x00,0x00,0x31,0xEC,0x66,0x66,0x33,0x76,0x36,0x63,0x66,0x01,0x0C,0x06,0x30,0x10,0xEC,0x33,0x10,0x2C,0x33,0xC1,0xCE,0x00,0x00,0x00},
    /*0x4D( 77)*/ {0x00,0x00,0x00,0x10,0xC0,0x66,0x63,0x36,0x66,0x66,0x33,0x66,0x13,0xC6,0x66,0x00,0x00,0x66,0x00,0x00,0x66,0x00,0x00,0x66,0x00,0x00,0x00},
    /*0x4E( 78)*/ {0x00,0x00,0x00,0x31,0xC8,0x66,0x66,0x66,0x66,0x36,0xC6,0x66,0x01,0x08,0x00,0x00,0xCC,0x66,0x00,0xCF,0x6E,0x00,0xFC,0xE6,0x00,0x00,0x00},
    /*0x4F( 79)*/ {0x00,0x00,0x00,0x31,0x6C,0x66,0x66,0x33,0x76,0x36,0x63,0x66,0x01,0x0C,0x06,0x10,0xF0,0xE0,0x11,0x88,0x66,0x11,0xF8,0xE6,0x00,0x00,0x00},
    /*0x50( 80)*/ {0x00,0x00,0x00,0x31,0x6C,0x66,0x66,0x33,0x66,0x36,0x63,0x66,0x01,0x0C,0x66,0x00,0xC0,0x06,0x00,0xCC,0x00,0x00,0xFC,0xE0,0x00,0x00,0x00},
    /*0x51( 81)*/ {0x00,0x00,0x00,0x10,0x9F,0x80,0x33,0x00,0xCC,0x01,0xF9,0x08,0x10,0x90,0x80,0x07,0x0F,0x0E,0x31,0x0F,0xC8,0x13,0xF0,0x8C,0x00,0x00,0x00},
    /*0x52( 82)*/ {0x00,0x00,0x00,0x10,0x9F,0x80,0x33,0x00,0xCC,0x13,0x10,0x8C,0x00,0x0F,0x00,0x10,0x90,0x80,0x71,0xF9,0xE8,0x00,0x00,0x00,0x00,0x00,0x00},
    /*0x53( 83)*/ {0x00,0x00,0x00,0x10,0x9F,0x80,0x33,0x00,0xCC,0x01,0xF9,0x08,0x70,0xF0,0xE0,0x30,0xF0,0xC0,0x33,0x00,0xCC,0x33,0xF0,0xCC,0x00,0x00,0x00},
    /*0x54( 84)*/ {0x00,0x00,0x00,0x31,0x6C,0x66,0x66,0x33,0x66,0x36,0x63,0x66,0x01,0x0C,0x66,0x17,0x8F,0x6E,0x11,0x88,0x66,0x11,0x08,0x66,0x00,0x00,0x00},
    /*0x55( 85)*/ {0x00,0x00,0x00,0x31,0x1F,0x80,0x66,0x00,0xCC,0x13,0xF1,0x08,0x00,0x60,0x00,0x0F,0x0F,0x0E,0x66,0x00,0x00,0x76,0xF0,0xC0,0x00,0x00,0x00},
    /*0x56( 86)*/ {0x00,0x00,0x00,0x10,0x80,0x66,0x63,0x6C,0x66,0x66,0x67,0x6E,0x36,0xC6,0x66,0x01,0x08,0x66,0x00,0x00,0x66,0x00,0x00,0x66,0x00,0x00,0x00},
    /*0x57( 87)*/ {0x00,0x00,0x00,0x31,0xC8,0x66,0x66,0x66,0xE6,0x36,0xC6,0x66,0x01,0x08,0x06,0x00,0xC0,0x00,0x00,0xCC,0x00,0x00,0xFC,0xE0,0x00,0x00,0x00},
    /*0x58( 88)*/ {0x00,0x00,0x00,0x31,0xC8,0x66,0x66,0x76,0xE6,0x36,0xC6,0x66,0x01,0x08,0x06,0x10,0xF0,0xE0,0x00,0x00,0x66,0x00,0x00,0x66,0x00,0x00,0x00},
    /*0x59( 89)*/ {0x00,0x00,0x00,0x21,0x2C,0x66,0x66,0x33,0x66,0x12,0xC2,0x66,0x70,0xF0,0x66,0x00,0xDC,0xE6,0x30,0x0C,0x06,0x33,0xF0,0xE0,0x00,0x00,0x00},
    /*0x5A( 90)*/ {0x00,0x00,0x00,0x10,0x9F,0x80,0x33,0x00,0xCC,0x01,0xF9,0x08,0x70,0xF0,0xE0,0x00,0x66,0x00,0x33,0x0F,0xCC,0x33,0xF0,0xCC,0x00,0x00,0x00},
    /*0x5B( 91)*/ {0x00,0x00,0x00,0xF0,0xF0,0xCC,0x11,0x88,0xCC,0x33,0xCC,0xFC,0x66,0x66,0xCC,0x0C,0x03,0xCC,0x00,0x00,0xCC,0x00,0x00,0xCC,0x00,0x00,0x00},
    /*0x5C( 92)*/ {0x00,0x00,0x00,0x07,0xCF,0x66,0x00,0xCC,0xE6,0x31,0x3E,0x66,0x06,0x01,0x0E,0x01,0x0F,0x6E,0x00,0x00,0x66,0x00,0x00,0x46,0x00,0x00,0x00},
    /*0x5D( 93)*/ {0x00,0x00,0x00,0xF1,0xF9,0xBB,0x11,0x99,0xBB,0x33,0xDD,0xFB,0x66,0x77,0xBB,0x0C,0x13,0xBB,0x00,0x11,0xBB,0x00,0x01,0x3B,0x00,0x00,0x00},
    /*0x5E( 94)*/ {0x00,0x00,0x00,0x70,0xF0,0xE6,0x00,0xCC,0x66,0x00,0xCD,0x6E,0x31,0x3E,0x66,0x06,0x01,0x6E,0x00,0x00,0x66,0x00,0x00,0x66,0x00,0x00,0x00},
    /*0x5F( 95)*/ {0x00,0x00,0x00,0x70,0xF0,0xE0,0x00,0x66,0x00,0x10,0x9F,0x80,0x63,0x00,0x6C,0x00,0x66,0x00,0xF0,0xF6,0xF0,0x00,0x00,0x00,0x00,0x00,0x00},
    /*0x60( 96)*/ {0x00,0x00,0x00,0x07,0xCF,0x66,0x00,0xCC,0xE6,0x31,0x3E,0x66,0x06,0x01,0x0E,0x00,0x63,0xC8,0x00,0xCC,0x66,0x00,0x36,0x8C,0x00,0x00,0x00},
    /*0x61( 97)*/ {0x00,0x00,0x00,0x03,0x6F,0x0C,0x10,0x9F,0x80,0x03,0x00,0x0C,0x07,0x6F,0x0E,0x10,0xF6,0x80,0x33,0x09,0xCC,0x13,0xF9,0x8C,0x00,0x00,0x00},
    /*0x62( 98)*/ {0x00,0x00,0x00,0x07,0xCF,0x66,0x00,0xCC,0x66,0x11,0xEE,0x66,0x33,0x33,0x66,0x06,0x01,0x6E,0x00,0x00,0x66,0x00,0x00,0x66,0x00,0x00,0x00},
    /*0x63( 99)*/ {0x00,0x00,0x00,0x07,0xCF,0x66,0x00,0xCC,0x66,0x31,0x3E,0x66,0x06,0x01,0x0E,0x00,0x0F,0x6E,0x00,0x00,0x66,0x00,0x00,0x46,0x00,0x00,0x00},
    /*0x64(100)*/ {0x00,0x00,0x00,0x70,0xFC,0x66,0x00,0xCC,0xE6,0x31,0x3E,0x66,0x06,0x01,0x0E,0x00,0x63,0xC8,0x00,0xCC,0x66,0x00,0x36,0x8C,0x00,0x00,0x00},
    /*0x65(101)*/ {0x00,0x00,0x00,0x00,0xCC,0x66,0x07,0xCF,0x6E,0x00,0xCC,0x66,0x11,0xEE,0x66,0x33,0x33,0x66,0x06,0x01,0x6E,0x00,0x00,0x66,0x00,0x00,0x00},
    /*0x66(102)*/ {0x00,0x00,0x00,0x00,0x66,0x00,0x07,0x6F,0x0E,0x10,0x9F,0x80,0x63,0x00,0x6C,0x00,0x66,0x00,0xF0,0xF6,0xF0,0x00,0x00,0x00,0x00,0x00,0x00},
    /*0x67(103)*/ {0x00,0x00,0x00,0x67,0x1D,0xBB,0x76,0xD1,0xFB,0x66,0x11,0xBB,0x07,0x0D,0x0B,0x00,0xF0,0xF0,0x00,0x00,0x33,0x00,0x00,0x23,0x00,0x00,0x00},
    /*0x68(104)*/ {0x00,0x00,0x00,0x37,0x6F,0x66,0x33,0x66,0x6E,0x33,0x66,0x6E,0x07,0x0F,0x06,0x00,0x63,0xC8,0x00,0xCC,0x66,0x00,0x36,0x8C,0x00,0x00,0x00},
    /*0x69(105)*/ {0x00,0x00,0x00,0x71,0xFC,0x66,0x10,0xC0,0x66,0x63,0x36,0x66,0x36,0x63,0x66,0x01,0x0C,0x66,0x00,0x00,0x66,0x00,0x00,0x66,0x00,0x00,0x00},
    /*0x6A(106)*/ {0x00,0x00,0x00,0x71,0xFC,0x66,0x10,0xC0,0x66,0x63,0x36,0x76,0x36,0x63,0x66,0x01,0x0C,0x06,0x33,0x00,0x00,0x33,0xF0,0xE0,0x00,0x00,0x00},
    /*0x6B(107)*/ {0x00,0x00,0x00,0x71,0xFC,0x66,0x10,0xC0,0x66,0x63,0x36,0x76,0x36,0x63,0x66,0x01,0x0C,0x66,0x00,0x00,0x66,0x00,0x00,0x66,0x00,0x00,0x00},
    /*0x6C(108)*/ {0x00,0x00,0x00,0x71,0xFC,0x66,0x31,0x6C,0x66,0x36,0x63,0x67,0x11,0xCC,0x66,0x07,0x0F,0x0E,0x01,0x0F,0x6E,0x00,0x00,0x66,0x00,0x00,0x04},
    /*0x6D(109)*/ {0x00,0x00,0x00,0x71,0xFC,0x66,0x10,0xC0,0x66,0x63,0x36,0x76,0x36,0x63,0x66,0x01,0x0C,0x66,0x00,0xCC,0x66,0x07,0x0F,0x6E,0x00,0x00,0x00},
    /*0x6E(110)*/ {0x00,0x00,0x00,0x30,0xF6,0xC0,0x00,0xF0,0x00,0x31,0x09,0xC8,0x13,0x90,0x8C,0x00,0x0F,0x00,0x00,0x66,0x00,0x07,0x0F,0x0E,0x00,0x00,0x00},
    /*0x6F(111)*/ {0x00,0x00,0x00,0x71,0xFC,0x66,0x10,0xC0,0xE6,0x63,0x36,0xE6,0x36,0x63,0x66,0x01,0x0C,0x06,0x10,0x8F,0x6C,0x01,0xF8,0xC6,0x00,0x00,0x00},
    /*0x70(112)*/ {0x00,0x00,0x00,0x71,0xFC,0x66,0x63,0x36,0x67,0x36,0x63,0x67,0x01,0x0C,0x46,0x00,0xC7,0xC8,0x11,0x88,0x66,0x00,0x7C,0x8C,0x00,0x00,0x00},
    /*0x71(113)*/ {0x00,0x00,0x00,0x00,0x00,0x00,0x00,0x00,0x00,0x00,0x00,0x00,0x00,0x00,0x00,0x00,0x00,0x00,0x00,0x00,0x00,0x00,0x00,0x00,0x00,0x00,0x00},
    /*0x72(114)*/ {0x00,0x10,0xFF,0x00,0x33,0x08,0x00,0x33,0x00,0x00,0x33,0x00,0x00,0x73,0xF0,0x00,0xFF,0xCF,0x00,0xFF,0xC8,0x00,0xFF,0xFC,0x00,0xFF,0xFF},
    /*0x73(115)*/ {0xEC,0x00,0x00,0x37,0x00,0x00,0x33,0x00,0x00,0x33,0x00,0x00,0xF3,0x80,0x00,0xFF,0xCC,0x00,0xF7,0xCC,0x00,0xFF,0xCC,0x00,0xFF,0xCC,0x00},
    /*0x74(116)*/ {0x00,0x00,0x00,0x00,0x00,0x00,0x00,0x00,0x00,0x00,0x00,0x00,0x00,0x70,0xF0,0x00,0xFF,0xCF,0x00,0xFF,0xC8,0x00,0xFF,0xFC,0x00,0xFF,0xFF},
    /*0x75(117)*/ {0x10,0xFF,0xEC,0x33,0x08,0x37,0x33,0x00,0x33,0x33,0x00,0x03,0xF3,0x80,0x00,0xFF,0xCC,0x00,0xF7,0xCC,0x00,0xFF,0xCC,0x00,0xFF,0xCC,0x00},
    /*0x76(118)*/ {0x00,0x00,0x00,0x00,0x00,0x00,0x00,0x00,0x00,0x00,0x00,0x00,0x00,0x00,0x00,0x00,0x00,0x00,0x00,0x00,0x00,0x00,0x00,0x00,0x00,0x00,0x10},
    /*0x77(119)*/ {0x00,0x00,0x73,0x00,0x00,0xE7,0x00,0x11,0xCC,0x00,0x33,0x88,0x00,0xE7,0x00,0x10,0xCE,0x00,0x33,0x88,0x00,0xE7,0x00,0x00,0xCE,0x00,0x00},
    /*0x78(120)*/ {0x00,0x00,0x33,0x00,0x00,0xE7,0x00,0x10,0xCE,0x00,0x33,0x88,0x00,0xE7,0x00,0x10,0xCE,0x00,0x33,0x88,0x00,0x77,0x00,0x00,0xCE,0x00,0x00},
    /*0x79(121)*/ {0x08,0x00,0x00,0x00,0x00,0x00,0x00,0x00,0x00,0x00,0x00,0x00,0x00,0x00,0x00,0x00,0x00,0x00,0x00,0x00,0x00,0x00,0x00,0x00,0x00,0x00,0x00},
    /*0x7A(122)*/ {0xEC,0x00,0x00,0x77,0x00,0x00,0x33,0x88,0x00,0x01,0xEC,0x00,0x00,0x7E,0x00,0x00,0x33,0x88,0x00,0x01,0xEC,0x00,0x00,0x7E,0x00,0x00,0x33},
    /*0x7B(123)*/ {0x00,0x00,0x00,0x00,0x00,0x00,0x00,0x00,0x00,0x00,0x00,0x00,0x00,0x00,0x00,0x00,0x00,0x00,0x00,0x00,0x00,0x00,0x00,0x00,0x80,0x00,0x00},
    /*0x7C(124)*/ {0x00,0x00,0x01,0x00,0x00,0x00,0x00,0x00,0x00,0x00,0x00,0x00,0x00,0x00,0x00,0x00,0x00,0x00,0x00,0x00,0x00,0x00,0x00,0x00,0x00,0x00,0x00},
    /*0x7D(125)*/ {0xCC,0x00,0x00,0x7E,0x00,0x00,0x37,0x80,0x00,0x11,0xCC,0x00,0x00,0x7E,0x00,0x00,0x37,0x80,0x00,0x11,0xCC,0x00,0x00,0xEE,0x00,0x00,0x37},
    /*0x7E(126)*/ {0xFF,0xFF,0xFF,0x00,0x00,0x00,0x00,0x00,0x00,0x00,0x00,0x00,0x00,0x00,0x00,0x00,0x00,0x00,0x00,0x00,0x00,0x00,0x00,0x00,0x00,0x00,0x00},
    /*0x7F(127)*/ {0x77,0xFF,0xFF,0x00,0x00,0x00,0x00,0x00,0x00,0x00,0x00,0x00,0x00,0x00,0x00,0x00,0x00,0x00,0x00,0x00,0x00,0x00,0x00,0x00,0x00,0x00,0x00},
    /*0x80(128)*/ {0x00,0x77,0xFF,0x00,0xC6,0x00,0x00,0xCC,0x00,0x11,0x88,0x00,0x31,0x08,0x00,0x33,0x00,0x00,0x66,0x00,0x00,0xC6,0x00,0x00,0xCC,0x00,0x00},
    /*0x81(129)*/ {0xFF,0xEE,0x00,0x00,0x36,0x00,0x00,0x33,0x00,0x00,0x11,0x88,0x00,0x01,0xC8,0x00,0x00,0xCC,0x00,0x00,0x66,0x00,0x00,0x36,0x00,0x00,0x33},
    /*0x82(130)*/ {0x00,0x00,0x11,0x00,0x00,0x31,0x00,0x00,0x33,0x00,0x00,0x66,0x00,0x00,0xC6,0x00,0x00,0xCC,0x00,0x11,0x88,0x00,0x31,0x08,0x00,0x33,0x00},
    /*0x83(131)*/ {0x00,0x66,0x00,0x00,0xC6,0x00,0x00,0xCC,0x00,0x11,0x88,0x00,0x31,0x08,0x00,0x33,0x00,0x00,0x66,0x00,0x00,0xC6,0x00,0x00,0xCC,0x00,0x00},
    /*0x84(132)*/ {0x88,0x00,0x00,0x08,0x00,0x00,0x00,0x00,0x00,0x00,0x00,0x00,0x00,0x00,0x00,0x00,0x00,0x00,0x00,0x00,0x00,0x00,0x00,0x00,0x00,0x00,0x00},
    /*0x85(133)*/ {0x88,0x00,0x00,0xC8,0x00,0x00,0xCC,0x00,0x00,0x66,0x00,0x00,0x36,0x00,0x00,0x33,0x00,0x00,0x11,0x88,0x00,0x01,0xC8,0x00,0x00,0xCC,0x00},
    /*0x86(134)*/ {0x00,0x66,0x00,0x00,0x36,0x00,0x00,0x33,0x00,0x00,0x11,0x88,0x00,0x01,0xC8,0x00,0x00,0xCC,0x00,0x00,0x66,0x00,0x00,0x36,0x00,0x00,0x33},
    /*0x87(135)*/ {0x00,0x00,0x11,0x00,0x00,0x01,0x00,0x00,0x00,0x00,0x00,0x00,0x00,0x00,0x00,0x00,0x00,0x00,0x00,0x00,0x00,0x00,0x00,0x00,0x00,0x00,0x00},
    /* Multi Color Font */
    /*0x88(136)*/ {0x00,0x00,0x30,0x00,0x00,0xF7,0x00,0x00,0xFF,0x00,0x00,0x37,0x00,0x00,0x70,0x00,0x31,0xFF,0x10,0xFF,0xFF,0x33,0xFF,0xFF,0x03,0x0F,0x0F},
    /*0x89(137)*/ {0xFF,0xFF,0xFF,0xFF,0xFF,0xFF,0xFF,0xFF,0xFF,0xFF,0xFF,0xFF,0xFF,0xFF,0xFF,0xFF,0xFF,0xFF,0xFF,0xFF,0xFF,0xFF,0xFF,0xFF,0xFF,0xFF,0xFF},
    /*0x8A(138)*/ {0xFF,0xFF,0xCF,0xFF,0xFF,0x7B,0xFF,0xFF,0x77,0xFF,0xFF,0xCB,0xFF,0xFF,0x8F,0xFF,0xDE,0xF7,0xEF,0x73,0xFF,0xCC,0xFF,0xFF,0xFC,0xF0,0xF0},
    /* Multi Color Font */
    /*0x8B(139)*/ {0xC0,0x00,0x00,0xFE,0x00,0x00,0xFF,0x00,0x00,0xCE,0x00,0x00,0xE0,0x00,0x00,0xFF,0xC8,0x00,0xFF,0xFF,0x80,0xFF,0xFF,0xCC,0x0F,0x0F,0x0C},
    /*0x8C(140)*/ {0xFF,0xFF,0xFF,0xFF,0xFF,0xFF,0xFF,0xFF,0xFF,0xFF,0xFF,0xFF,0xFF,0xFF,0xFF,0xFF,0xFF,0xFF,0xFF,0xFF,0xFF,0xFF,0xFF,0xFF,0xFF,0xFF,0xFF},
    /*0x8D(141)*/ {0x3F,0xFF,0xFF,0xED,0xFF,0xFF,0xEE,0xFF,0xFF,0x3D,0xFF,0xFF,0x1F,0xFF,0xFF,0xFE,0xB7,0xFF,0xFF,0xEC,0x7F,0xFF,0xFF,0x33,0xF0,0xF0,0xF3},
    /* Multi Color Font */
    /*0x8E(142)*/ {0x00,0x00,0x00,0x00,0x00,0x00,0x00,0x00,0x00,0x00,0x00,0x00,0x00,0x00,0x00,0x00,0x00,0x00,0x00,0x20,0x00,0x00,0x04,0x00,0x00,0x00,0x00},
    /*0x8F(143)*/ {0xFF,0xFF,0xFF,0xFF,0xFF,0xFF,0xFF,0xFF,0xFF,0xFF,0xFF,0xFF,0xFF,0xFF,0xFF,0xFF,0xFF,0xFF,0xFF,0xFF,0xFF,0xFF,0xFF,0xFF,0xFF,0xFF,0xFF},
    /*0x90(144)*/ {0xFF,0xFF,0xFF,0xFF,0xFF,0xCF,0xFF,0xFF,0xBB,0xFF,0xFF,0x8B,0xFF,0xFF,0x73,0xFF,0xCF,0x77,0xFF,0x28,0x77,0xFF,0x04,0xE6,0xFF,0xF9,0xFF},
    /* Multi Color Font */
    /*0x91(145)*/ {0x00,0x00,0x00,0x00,0x00,0x00,0x00,0x00,0x00,0x00,0x00,0x00,0x00,0x00,0x00,0x00,0x00,0x00,0x00,0x00,0x00,0x84,0x00,0x00,0x00,0x00,0x00},
    /*0x92(146)*/ {0xFF,0xFF,0xFF,0xFF,0xFF,0xFF,0xFF,0xFF,0xFF,0xFF,0xFF,0xFF,0xFF,0xFF,0xFF,0xFF,0xFF,0xFF,0xFF,0xFF,0xFF,0xFF,0xFF,0xFF,0xFF,0xFF,0xFF},
    /*0x93(147)*/ {0xFF,0xFF,0xFF,0x3C,0xB3,0xFF,0xFF,0xBB,0xFF,0x78,0xB3,0xFF,0xFF,0x77,0xFF,0xFF,0x77,0xFF,0x08,0x77,0xFF,0x84,0xF7,0xFF,0xF1,0xFF,0xFF},
    /* Multi Color Font */
    /*0x94(148)*/ {0x00,0x00,0x00,0x00,0x00,0x00,0x00,0xF0,0xF0,0x00,0xFF,0xCC,0x00,0xFF,0xCC,0x00,0xFF,0xCC,0x00,0xFF,0xCC,0x00,0xFF,0xFC,0x00,0x00,0x00},
    /*0x95(149)*/ {0xFF,0xFF,0xB7,0xFF,0xFF,0xED,0xCE,0xF0,0xF0,0xCC,0xCC,0x33,0xCC,0xCC,0x33,0xCC,0xCC,0x33,0xCC,0xCC,0x33,0xCC,0xFC,0xF3,0xFE,0xF0,0xF0},
    /*0x96(150)*/ {0xFF,0xFF,0xFF,0xFF,0xFF,0xFF,0xFF,0xFF,0xFF,0xFF,0xCC,0x00,0xFF,0xCC,0x00,0xFF,0xCC,0x00,0xFF,0xCC,0x00,0xFF,0xFC,0xF0,0xFF,0xFF,0xFF},
    /* Multi Color Font */
    /*0x97(151)*/ {0x00,0x00,0x00,0x00,0x00,0x00,0xF0,0xF0,0x00,0x33,0xFF,0x00,0x33,0xFF,0x00,0x33,0xFF,0x00,0x33,0xFF,0x00,0xF3,0xFF,0x00,0x00,0x00,0x00},
    /*0x98(152)*/ {0xDE,0xFF,0xFF,0x7B,0xFF,0xFF,0xF0,0xF0,0x37,0xCC,0x33,0x33,0xCC,0x33,0x33,0xCC,0x33,0x33,0xCC,0x33,0x33,0xFC,0xF3,0x33,0xF0,0xF0,0xF7},
    /*0x99(153)*/ {0xFF,0xFF,0xFF,0xFF,0xFF,0xFF,0xFF,0xFF,0xFF,0x33,0xFF,0xFF,0x33,0xFF,0xFF,0x33,0xFF,0xFF,0x33,0xFF,0xFF,0xF3,0xFF,0xFF,0xFF,0xFF,0xFF},
    /* Multi Color Font */
    /*0x9A(154)*/ {0x10,0xF0,0xF0,0x73,0xFF,0xFF,0x77,0xFF,0xFF,0x13,0xFF,0xFF,0x00,0x00,0x00,0x00,0x00,0x00,0x00,0x00,0x00,0x00,0x00,0x00,0x00,0x00,0x00},
    /*0x9B(155)*/ {0xEF,0x0F,0x0F,0xBD,0xFF,0xFF,0xBB,0xFF,0xFF,0xED,0x0F,0x0F,0xFF,0xFF,0xFF,0xFF,0x98,0xFF,0xFF,0xFA,0x1F,0xFF,0xFF,0xFF,0xFF,0xFF,0xFF},
    /*0x9C(156)*/ {0xEF,0x0F,0x0F,0xAD,0xAF,0xAF,0xAB,0xAF,0xAF,0xED,0x0F,0x0F,0xFF,0xFF,0xFF,0xFF,0xFF,0xFF,0xFF,0xFF,0xFF,0xFF,0xFF,0xFF,0xFF,0xFF,0xFF},
    /* Multi Color Font */
    /*0x9D(157)*/ {0x00,0x00,0x00,0xC8,0x00,0x00,0xCC,0x00,0x00,0x08,0x00,0x00,0x00,0x00,0x00,0x00,0xF7,0x80,0x11,0xFF,0xCC,0x01,0xFF,0x8C,0x00,0x07,0x00},
    /*0x9E(158)*/ {0xFF,0xFF,0xFF,0xB7,0xFF,0xFF,0xBB,0xD3,0x7F,0xF7,0xCE,0x77,0xFF,0xFF,0xFF,0xFF,0x78,0x7F,0xEE,0xFF,0xBB,0xFE,0x7F,0x7B,0xFF,0xF8,0xFF},
    /*0x9F(159)*/ {0xFF,0xFF,0xFF,0xB7,0xFF,0xFF,0xBB,0xFF,0xFF,0xF7,0xFF,0xFF,0xFF,0xFF,0xFF,0xFF,0x78,0x7F,0xEE,0xDF,0xBB,0xFE,0x7F,0x7B,0xFF,0xF8,0xFF},
    /* Multi Color Font */
    /*0xA0(160)*/ {0x00,0x00,0x00,0x00,0x10,0x87,0x00,0x42,0x00,0x00,0x84,0x00,0x00,0x88,0x11,0x00,0x88,0x31,0x00,0x44,0xD7,0x00,0x12,0x00,0x00,0x00,0x0F},
    /*0xA1(161)*/ {0xFF,0xFF,0xFF,0xFF,0xFF,0xFF,0xFF,0xFF,0xFF,0xFF,0xFF,0xFF,0xFF,0xFF,0xFF,0xFF,0xFF,0xFF,0xFF,0xFF,0xFF,0xFF,0xFF,0xFF,0xFF,0xFF,0xFF},
    /*0xA2(162)*/ {0xFF,0xFF,0xFF,0xFF,0xEF,0x78,0xFF,0xBD,0xFF,0xFF,0x7B,0xFF,0xFF,0x77,0xEE,0xFF,0x77,0xCE,0xFF,0xBB,0x28,0xFF,0xED,0xFF,0xFF,0xFF,0xF0},
    /* Multi Color Font */
    /*0xA3(163)*/ {0x00,0x00,0x00,0x1E,0x80,0x00,0xC0,0x24,0x00,0x0C,0x12,0x00,0x88,0x11,0x00,0x00,0x11,0x00,0xC2,0x22,0x00,0x10,0x84,0x00,0x0E,0x00,0x00},
    /*0xA4(164)*/ {0xFF,0xFF,0xFF,0xFF,0xFF,0xFF,0xFF,0xFF,0xFF,0xFF,0xFF,0xFF,0xFF,0xFF,0xFF,0xFF,0xFF,0xFF,0xFF,0xFF,0xFF,0xFF,0xFF,0xFF,0xFF,0xFF,0xFF},
    /*0xA5(165)*/ {0xFF,0xFF,0xFF,0xE1,0x7F,0xFF,0x3F,0xDB,0xFF,0xF3,0xED,0xFF,0x77,0xEE,0xFF,0xFF,0xEE,0xFF,0x3D,0xDD,0xFF,0xEF,0x7B,0xFF,0xF1,0xFF,0xFF},
    /* Multi Color Font */
    /*0xA6(166)*/ {0x00,0x00,0x00,0x00,0x00,0x00,0x00,0x00,0x00,0x00,0x00,0x00,0x00,0x00,0x00,0x00,0x00,0x00,0x00,0x20,0x00,0x00,0x04,0x00,0x00,0x00,0x00},
    /*0xA7(167)*/ {0xFF,0xFF,0xFF,0xFF,0xFF,0xFF,0xFF,0xFF,0xFF,0xFF,0xFF,0xFF,0xFF,0xFF,0xFF,0xFF,0xFF,0xFF,0xFF,0xFF,0xFF,0xFF,0xFF,0xFF,0xFF,0xFF,0xFF},
    /*0xA8(168)*/ {0xFF,0xFF,0xFF,0xFF,0xFF,0xCF,0xFF,0xFF,0xBB,0xFF,0xFF,0x8B,0xFF,0xFF,0x73,0xFF,0xCF,0x77,0xFF,0x28,0x77,0xFF,0x04,0xE6,0xFF,0xF9,0xFF},
    /* Multi Color Font */
    /*0xA9(169)*/ {0x00,0x00,0x00,0x00,0x00,0x00,0x00,0x00,0x00,0x00,0x00,0x00,0x00,0x00,0x00,0x00,0x00,0x00,0x00,0x00,0x00,0x84,0x00,0x00,0x00,0x00,0x00},
    /*0xAA(170)*/ {0xFF,0xFF,0xFF,0xFF,0xFF,0xFF,0xFF,0xFF,0xFF,0xFF,0xFF,0xFF,0xFF,0xFF,0xFF,0xFF,0xFF,0xFF,0xFF,0xFF,0xFF,0xFF,0xFF,0xFF,0xFF,0xFF,0xFF},
    /*0xAB(171)*/ {0xFF,0xFF,0xFF,0x3C,0xB3,0xFF,0xFF,0xBB,0xFF,0x78,0xB3,0xFF,0xFF,0x77,0xFF,0xFF,0x77,0xFF,0x08,0x77,0xFF,0x84,0xF7,0xFF,0xF1,0xFF,0xFF},
    /* Multi Color Font */
    /*0xAC(172)*/ {0x00,0x00,0x00,0x00,0x10,0x87,0x00,0x42,0x00,0x00,0x84,0x00,0x00,0x88,0x11,0x00,0x88,0x31,0x00,0x44,0xD7,0x00,0x12,0x00,0x00,0x00,0x0F},
    /*0xAD(173)*/ {0xFF,0xFF,0xFF,0xFF,0xFF,0xFF,0xFF,0xFF,0xFF,0xFF,0xFF,0xFF,0xFF,0xFF,0xFF,0xFF,0xFF,0xFF,0xFF,0xFF,0xFF,0xFF,0xFF,0xFF,0xFF,0xFF,0xFF},
    /*0xAE(174)*/ {0xFF,0xFF,0xFF,0xFF,0xEF,0x78,0xFF,0xBD,0xFF,0xFF,0x7B,0xFF,0xFF,0x77,0xEE,0xFF,0x77,0xCE,0xFF,0xBB,0x28,0xFF,0xED,0xFF,0xFF,0xFF,0xF0},
    /* Multi Color Font */
    /*0xAF(175)*/ {0x00,0x00,0x00,0x1E,0x80,0x00,0xC0,0x24,0x00,0x0C,0x12,0x00,0x88,0x11,0x00,0x00,0x11,0x00,0xC2,0x22,0x00,0x10,0x84,0x00,0x0E,0x00,0x00},
    /*0xB0(176)*/ {0xFF,0xFF,0xFF,0xFF,0xFF,0xFF,0xFF,0xFF,0xFF,0xFF,0xFF,0xFF,0xFF,0xFF,0xFF,0xFF,0xFF,0xFF,0xFF,0xFF,0xFF,0xFF,0xFF,0xFF,0xFF,0xFF,0xFF},
    /*0xB1(177)*/ {0xFF,0xFF,0xFF,0xE1,0x7F,0xFF,0x3F,0xDB,0xFF,0xF3,0xED,0xFF,0x77,0xEE,0xFF,0xFF,0xEE,0xFF,0x3D,0xDD,0xFF,0xEF,0x7B,0xFF,0xF1,0xFF,0xFF},
    /* Multi Color Font */
    /*0xB2(178)*/ {0x00,0x00,0x00,0x00,0x00,0x00,0x00,0xF0,0xF0,0x00,0xFF,0xCC,0x00,0xFF,0xCC,0x00,0xFF,0xCC,0x00,0xFF,0xCC,0x00,0xFF,0xFC,0x00,0x00,0x00},
    /*0xB3(179)*/ {0xFF,0xFF,0xB7,0xFF,0xFF,0xED,0xCE,0xF0,0xF0,0xCC,0xCC,0x33,0xCC,0xCC,0x33,0xCC,0xCC,0x33,0xCC,0xCC,0x33,0xCC,0xFC,0xF3,0xFE,0xF0,0xF0},
    /*0xB4(180)*/ {0xFF,0xFF,0xFF,0xFF,0xFF,0xFF,0xFF,0xFF,0xFF,0xFF,0xCC,0x00,0xFF,0xCC,0x00,0xFF,0xCC,0x00,0xFF,0xCC,0x00,0xFF,0xFC,0xF0,0xFF,0xFF,0xFF},
    /* Multi Color Font */
    /*0xB5(181)*/ {0x00,0x00,0x00,0x00,0x00,0x00,0x00,0xF0,0xF0,0x00,0xFF,0xCC,0x00,0xFF,0xCC,0x00,0xFF,0xCC,0x00,0xFF,0xCC,0x00,0xFF,0xFC,0x00,0x00,0x00},
    /*0xB6(182)*/ {0xFF,0xFF,0xB7,0xFF,0xFF,0xED,0xCE,0xF0,0xF0,0xCC,0xCC,0x33,0xCC,0xCC,0x33,0xCC,0xCC,0x33,0xCC,0xCC,0x33,0xCC,0xFC,0xF3,0xFE,0xF0,0xF0},
    /*0xB7(183)*/ {0xFF,0xFF,0xFF,0xFF,0xFF,0xFF,0xFF,0xFF,0xFF,0xFF,0xCC,0x00,0xFF,0xCC,0x00,0xFF,0xCC,0x00,0xFF,0xCC,0x00,0xFF,0xFC,0xF0,0xFF,0xFF,0xFF},
    /* Multi Color Font */
    /*0xB8(184)*/ {0x00,0x00,0x00,0x00,0x00,0x00,0x00,0xF0,0xF0,0x00,0xFF,0xCC,0x00,0xFF,0xCC,0x00,0xFF,0xCC,0x00,0xFF,0xCC,0x00,0xFF,0xFC,0x00,0x00,0x00},
    /*0xB9(185)*/ {0xFF,0xFF,0xB7,0xFF,0xFF,0xED,0xCE,0xF0,0xF0,0xCC,0xCC,0x33,0xCC,0xCC,0x33,0xCC,0xCC,0x33,0xCC,0xCC,0x33,0xCC,0xFC,0xF3,0xFE,0xF0,0xF0},
    /*0xBA(186)*/ {0xFF,0xFF,0xFF,0xFF,0xFF,0xFF,0xFF,0xFF,0xFF,0xFF,0xCC,0x00,0xFF,0xCC,0x00,0xFF,0xCC,0x00,0xFF,0xCC,0x00,0xFF,0xFC,0xF0,0xFF,0xFF,0xFF},
    /* Multi Color Font */
    /*0xBB(187)*/ {0x00,0x00,0x00,0x00,0x00,0x00,0x00,0xF0,0xF0,0x00,0xFF,0xCC,0x00,0xFF,0xCC,0x00,0xFF,0xCC,0x00,0xFF,0xCC,0x00,0xFF,0xFC,0x00,0x00,0x00},
    /*0xBC(188)*/ {0xFF,0xFF,0xB7,0xFF,0xFF,0xED,0xCE,0xF0,0xF0,0xCC,0xCC,0x33,0xCC,0xCC,0x33,0xCC,0xCC,0x33,0xCC,0xCC,0x33,0xCC,0xFC,0xF3,0xFE,0xF0,0xF0},
    /*0xBD(189)*/ {0xFF,0xFF,0xFF,0xFF,0xFF,0xFF,0xFF,0xFF,0xFF,0xFF,0xCC,0x00,0xFF,0xCC,0x00,0xFF,0xCC,0x00,0xFF,0xCC,0x00,0xFF,0xFC,0xF0,0xFF,0xFF,0xFF},
    /* Multi Color Font */
    /*0xBE(190)*/ {0x00,0x00,0x00,0x00,0x00,0x00,0x00,0xF0,0xF0,0x00,0xFF,0xCC,0x00,0xFF,0xCC,0x00,0xFF,0xCC,0x00,0xFF,0xCC,0x00,0xFF,0xFC,0x00,0x00,0x00},
    /*0xBF(191)*/ {0xFF,0xFF,0xB7,0xFF,0xFF,0xED,0xCE,0xF0,0xF0,0xCC,0xCC,0x33,0xCC,0xCC,0x33,0xCC,0xCC,0x33,0xCC,0xCC,0x33,0xCC,0xFC,0xF3,0xFE,0xF0,0xF0},
    /*0xC0(192)*/ {0xFF,0xFF,0xFF,0xFF,0xFF,0xFF,0xFF,0xFF,0xFF,0xFF,0xCC,0x00,0xFF,0xCC,0x00,0xFF,0xCC,0x00,0xFF,0xCC,0x00,0xFF,0xFC,0xF0,0xFF,0xFF,0xFF},
    /* Multi Color Font */
    /*0xC1(193)*/ {0x00,0x00,0x00,0x00,0x00,0x00,0xF0,0xF0,0x00,0x33,0xFF,0x00,0x33,0xFF,0x00,0x33,0xFF,0x00,0x33,0xFF,0x00,0xF3,0xFF,0x00,0x00,0x00,0x00},
    /*0xC2(194)*/ {0xDE,0xFF,0xFF,0x7B,0xFF,0xFF,0xF0,0xF0,0x37,0xCC,0x33,0x33,0xCC,0x33,0x33,0xCC,0x33,0x33,0xCC,0x33,0x33,0xFC,0xF3,0x33,0xF0,0xF0,0xF7},
    /*0xC3(195)*/ {0xFF,0xFF,0xFF,0xFF,0xFF,0xFF,0xFF,0xFF,0xFF,0x33,0xFF,0xFF,0x33,0xFF,0xFF,0x33,0xFF,0xFF,0x33,0xFF,0xFF,0xF3,0xFF,0xFF,0xFF,0xFF,0xFF},
    /* Multi Color Font */
    /*0xC4(196)*/ {0x00,0x00,0x00,0x00,0x00,0x00,0xF0,0xF0,0x00,0x33,0xFF,0x00,0x33,0xFF,0x00,0x33,0xFF,0x00,0x33,0xFF,0x00,0xF3,0xFF,0x00,0x00,0x00,0x00},
    /*0xC5(197)*/ {0xDE,0xFF,0xFF,0x7B,0xFF,0xFF,0xF0,0xF0,0x37,0xCC,0x33,0x33,0xCC,0x33,0x33,0xCC,0x33,0x33,0xCC,0x33,0x33,0xFC,0xF3,0x33,0xF0,0xF0,0xF7},
    /*0xC6(198)*/ {0xFF,0xFF,0xFF,0xFF,0xFF,0xFF,0xFF,0xFF,0xFF,0x33,0xFF,0xFF,0x33,0xFF,0xFF,0x33,0xFF,0xFF,0x33,0xFF,0xFF,0xF3,0xFF,0xFF,0xFF,0xFF,0xFF},
    /* Multi Color Font */
    /*0xC7(199)*/ {0x00,0x00,0x00,0x00,0x00,0x00,0xF0,0xF0,0x00,0x33,0xFF,0x00,0x33,0xFF,0x00,0x33,0xFF,0x00,0x33,0xFF,0x00,0xF3,0xFF,0x00,0x00,0x00,0x00},
    /*0xC8(200)*/ {0xDE,0xFF,0xFF,0x7B,0xFF,0xFF,0xF0,0xF0,0x37,0xCC,0x33,0x33,0xCC,0x33,0x33,0xCC,0x33,0x33,0xCC,0x33,0x33,0xFC,0xF3,0x33,0xF0,0xF0,0xF7},
    /*0xC9(201)*/ {0xFF,0xFF,0xFF,0xFF,0xFF,0xFF,0xFF,0xFF,0xFF,0x33,0xFF,0xFF,0x33,0xFF,0xFF,0x33,0xFF,0xFF,0x33,0xFF,0xFF,0xF3,0xFF,0xFF,0xFF,0xFF,0xFF},
    /* Multi Color Font */
    /*0xCA(202)*/ {0x00,0x00,0x00,0x00,0x00,0x00,0xF0,0xF0,0x00,0x33,0xFF,0x00,0x33,0xFF,0x00,0x33,0xFF,0x00,0x33,0xFF,0x00,0xF3,0xFF,0x00,0x00,0x00,0x00},
    /*0xCB(203)*/ {0xDE,0xFF,0xFF,0x7B,0xFF,0xFF,0xF0,0xF0,0x37,0xCC,0x33,0x33,0xCC,0x33,0x33,0xCC,0x33,0x33,0xCC,0x33,0x33,0xFC,0xF3,0x33,0xF0,0xF0,0xF7},
    /*0xCC(204)*/ {0xFF,0xFF,0xFF,0xFF,0xFF,0xFF,0xFF,0xFF,0xFF,0x33,0xFF,0xFF,0x33,0xFF,0xFF,0x33,0xFF,0xFF,0x33,0xFF,0xFF,0xF3,0xFF,0xFF,0xFF,0xFF,0xFF},
    /* Multi Color Font */
    /*0xCD(205)*/ {0x00,0x00,0x00,0x00,0x00,0x00,0xF0,0xF0,0x00,0x33,0xFF,0x00,0x33,0xFF,0x00,0x33,0xFF,0x00,0x33,0xFF,0x00,0xF3,0xFF,0x00,0x00,0x00,0x00},
    /*0xCE(206)*/ {0xDE,0xFF,0xFF,0x7B,0xFF,0xFF,0xF0,0xF0,0x37,0xCC,0x33,0x33,0xCC,0x33,0x33,0xCC,0x33,0x33,0xCC,0x33,0x33,0xFC,0xF3,0x33,0xF0,0xF0,0xF7},
    /*0xCF(207)*/ {0xFF,0xFF,0xFF,0xFF,0xFF,0xFF,0xFF,0xFF,0xFF,0x33,0xFF,0xFF,0x33,0xFF,0xFF,0x33,0xFF,0xFF,0x33,0xFF,0xFF,0xF3,0xFF,0xFF,0xFF,0xFF,0xFF},
    /* Multi Color Font */
    /*0xD0(208)*/ {0x00,0x00,0x30,0x00,0x00,0xF7,0x00,0x00,0xFF,0x00,0x00,0x37,0x00,0x00,0x70,0x00,0x31,0xFF,0x10,0xFF,0xFF,0x33,0xFF,0xFF,0x03,0x0F,0x0F},
    /*0xD1(209)*/ {0xFF,0xFF,0xFF,0xFF,0xFF,0xFF,0xFF,0xFF,0xFF,0xFF,0xFF,0xFF,0xFF,0xFF,0xFF,0xFF,0xFF,0xFF,0xFF,0xFF,0xFF,0xFF,0xFF,0xFF,0xFF,0xFF,0xFF},
    /*0xD2(210)*/ {0xFF,0xFF,0xCF,0xFF,0xFF,0x7B,0xFF,0xFF,0x77,0xFF,0xFF,0xCB,0xFF,0xFF,0x8F,0xFF,0xDE,0xF7,0xEF,0x73,0xFF,0xCC,0xFF,0xFF,0xFC,0xF0,0xF0},
    /* Multi Color Font */
    /*0xD3(211)*/ {0x00,0x00,0x30,0x00,0x00,0xF7,0x00,0x00,0xFF,0x00,0x00,0x37,0x00,0x00,0x70,0x00,0x31,0xFF,0x10,0xFF,0xFF,0x33,0xFF,0xFF,0x03,0x0F,0x0F},
    /*0xD4(212)*/ {0xFF,0xFF,0xFF,0xFF,0xFF,0xFF,0xFF,0xFF,0xFF,0xFF,0xFF,0xFF,0xFF,0xFF,0xFF,0xFF,0xFF,0xFF,0xFF,0xFF,0xFF,0xFF,0xFF,0xFF,0xFF,0xFF,0xFF},
    /*0xD5(213)*/ {0xFF,0xFF,0xCF,0xFF,0xFF,0x7B,0xFF,0xFF,0x77,0xFF,0xFF,0xCB,0xFF,0xFF,0x8F,0xFF,0xDE,0xF7,0xEF,0x73,0xFF,0xCC,0xFF,0xFF,0xFC,0xF0,0xF0},
    /* Multi Color Font */
    /*0xD6(214)*/ {0x00,0x00,0x30,0x00,0x00,0xF7,0x00,0x00,0xFF,0x00,0x00,0x37,0x00,0x00,0x70,0x00,0x31,0xFF,0x10,0xFF,0xFF,0x33,0xFF,0xFF,0x03,0x0F,0x0F},
    /*0xD7(215)*/ {0xFF,0xFF,0xFF,0xFF,0xFF,0xFF,0xFF,0xFF,0xFF,0xFF,0xFF,0xFF,0xFF,0xFF,0xFF,0xFF,0xFF,0xFF,0xFF,0xFF,0xFF,0xFF,0xFF,0xFF,0xFF,0xFF,0xFF},
    /*0xD8(216)*/ {0xFF,0xFF,0xCF,0xFF,0xFF,0x7B,0xFF,0xFF,0x77,0xFF,0xFF,0xCB,0xFF,0xFF,0x8F,0xFF,0xDE,0xF7,0xEF,0x73,0xFF,0xCC,0xFF,0xFF,0xFC,0xF0,0xF0},
    /* Multi Color Font */
    /*0xD9(217)*/ {0xC0,0x00,0x00,0xFE,0x00,0x00,0xFF,0x00,0x00,0xCE,0x00,0x00,0xE0,0x00,0x00,0xFF,0xC8,0x00,0xFF,0xFF,0x80,0xFF,0xFF,0xCC,0x0F,0x0F,0x0C},
    /*0xDA(218)*/ {0xFF,0xFF,0xFF,0xFF,0xFF,0xFF,0xFF,0xFF,0xFF,0xFF,0xFF,0xFF,0xFF,0xFF,0xFF,0xFF,0xFF,0xFF,0xFF,0xFF,0xFF,0xFF,0xFF,0xFF,0xFF,0xFF,0xFF},
    /*0xDB(219)*/ {0x3F,0xFF,0xFF,0xED,0xFF,0xFF,0xEE,0xFF,0xFF,0x3D,0xFF,0xFF,0x1F,0xFF,0xFF,0xFE,0xB7,0xFF,0xFF,0xEC,0x7F,0xFF,0xFF,0x33,0xF0,0xF0,0xF3},
    /* Multi Color Font */
    /*0xDC(220)*/ {0xC0,0x00,0x00,0xFE,0x00,0x00,0xFF,0x00,0x00,0xCE,0x00,0x00,0xE0,0x00,0x00,0xFF,0xC8,0x00,0xFF,0xFF,0x80,0xFF,0xFF,0xCC,0x0F,0x0F,0x0C},
    /*0xDD(221)*/ {0xFF,0xFF,0xFF,0xFF,0xFF,0xFF,0xFF,0xFF,0xFF,0xFF,0xFF,0xFF,0xFF,0xFF,0xFF,0xFF,0xFF,0xFF,0xFF,0xFF,0xFF,0xFF,0xFF,0xFF,0xFF,0xFF,0xFF},
    /*0xDE(222)*/ {0x3F,0xFF,0xFF,0xED,0xFF,0xFF,0xEE,0xFF,0xFF,0x3D,0xFF,0xFF,0x1F,0xFF,0xFF,0xFE,0xB7,0xFF,0xFF,0xEC,0x7F,0xFF,0xFF,0x33,0xF0,0xF0,0xF3},
    /* Multi Color Font */
    /*0xDF(223)*/ {0xC0,0x00,0x00,0xFE,0x00,0x00,0xFF,0x00,0x00,0xCE,0x00,0x00,0xE0,0x00,0x00,0xFF,0xC8,0x00,0xFF,0xFF,0x80,0xFF,0xFF,0xCC,0x0F,0x0F,0x0C},
    /*0xE0(224)*/ {0xFF,0xFF,0xFF,0xFF,0xFF,0xFF,0xFF,0xFF,0xFF,0xFF,0xFF,0xFF,0xFF,0xFF,0xFF,0xFF,0xFF,0xFF,0xFF,0xFF,0xFF,0xFF,0xFF,0xFF,0xFF,0xFF,0xFF},
    /*0xE1(225)*/ {0x3F,0xFF,0xFF,0xED,0xFF,0xFF,0xEE,0xFF,0xFF,0x3D,0xFF,0xFF,0x1F,0xFF,0xFF,0xFE,0xB7,0xFF,0xFF,0xEC,0x7F,0xFF,0xFF,0x33,0xF0,0xF0,0xF3},
    /* Multi Color Font */
    /*0xE2(226)*/ {0x00,0x00,0x30,0x00,0x00,0xF7,0x00,0x00,0xFF,0x00,0x00,0x37,0x00,0x00,0x70,0x00,0x31,0xFF,0x10,0xFF,0xFF,0x33,0xFF,0xFF,0x03,0x0F,0x0F},
    /*0xE3(227)*/ {0xFF,0xFF,0xFF,0xFF,0xFF,0xFF,0xFF,0xFF,0xFF,0xFF,0xFF,0xFF,0xFF,0xFF,0xFF,0xFF,0xFF,0xFF,0xFF,0xFF,0xFF,0xFF,0xFF,0xFF,0xFF,0xFF,0xFF},
    /*0xE4(228)*/ {0xFF,0xFF,0xCF,0xFF,0xFF,0x7B,0xFF,0xFF,0x77,0xFF,0xFF,0xCB,0xFF,0xFF,0x8F,0xFF,0xDE,0xF7,0xEF,0x73,0xFF,0xCC,0xFF,0xFF,0xFC,0xF0,0xF0}
};