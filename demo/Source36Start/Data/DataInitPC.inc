/*
DATA INIT FILE
*/
CODE BYTE DataInitNTSC[] = {
0x00, 0x00,		//START


//------------
//--- Page 00
//------------
0xFF, 0x00,	// //--- Page 00
0x06, 0x06,	// // TSCP,TRSP
//$$$#if defined(PANEL_SRGB)
//$$$	0x07, 0x01,		// Serial RGB
//$$$#elif defined(PANEL_FP_LSB)	
//$$$	0x07, 0x02,		// FP LSB
//$$$#else
//$$$	0x07, 0x00,		// TCON
//$$$#endif			
////////0x08 40 // *** Output enable
0x1F, 0x00,	// // Disable Test mode
0x40, 0x10,	// // Input=Decoder
0x41, 0x0C,	// // Color=YCbCr
0x5F, 0x00,	// // Disable Test pattern

////--- SSPLL
0xF6, 0x00,	//PCLK_div_by_1 SPICLK_div_by_1
0xF7, 0x16,	//
			//SSPLL 108MHz
0xF8, 0x02,	//0xF8, 0x01,	//
0xF9, 0x00,	//0xF9, 0xE0,	//default 0x50,
0xFA, 0x00,	//0xFA, 0x00,	//
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0xE0, 0x01,	//PLL108

//------------
//--- Page 01
//------------
0xFF, 0x01,	// 
////--- Decoder
0x1C, 0x0F,	// // *** Disable Shadow
0x02, 0x40,	//
0x04, 0x00,	//
#ifdef MODEL_TW8836
//move to REG1E8
#else
0x05, 0x2F,	//
#endif
0x06, 0x03,	//
0x07, 0x02,	//
0x08, 0x12,	//REG108
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0x35, 0x00,	//
////--- ADC, LLPLL
0xC0, 0x01,	// // Clock=27M
0xCB, 0x30,	// // PD. LLPLL,SOG
0xE2, 0xD9,	// // Bias
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0xE7, 0x2A,	// // AAF on
#ifdef MODEL_TW8836
0xE8, 0x2f,		//Reserved def 0x0E
#endif
//------------
//--- Page 02
//------------
0xFF, 0x02,	//  // Page 02
////--- scaler
0x01, 0x00,
0x02, 0x20,
0x03, 0x00,
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0x10, 0x21,	//default 0x28
//0x11, 0x21,	//scaler output width = 801(0x321)
//0x12, 0x03,	//BKFYI.Use value that assigned at InitWithNTSC()
0x13, 0x00,
0x14, 0x20,
0x15, 0x2E,
//0x16, 0xE0,	//BKFYI.Use value that assigned at InitWithNTSC()
//0x17, 0x01,
0x18, 0x00,
0x19, 0x10,	//!	VTOTAL	R20D[7:6]R209[7:0]	0x210(528)
0x1A, 0x00,
0x1B, 0x00,
0x1C, 0x42, //with AUTO
0x1D, 0x00,	//!	HTOTAL R21C[7:4]R21D[7;0] 0x400(1024)		
0x1E, 0x03,	//default 0x00. FW will change R21E[0]. R21E[1] is fixed as "1"
////--- TCON  120510: InitWithNTSC write TCON. We don't need to overwite save value again
//$$$0x40, 0x10,
//$$$0x41, 0x00,
//$$$0x42, 0x05,
//$$$0x43, 0x01,
//$$$0x44, 0x64,
//$$$0x45, 0xF4,
//$$$0x46, 0x00,
//$$$0x47, 0x0A,
//$$$0x48, 0x36,
//$$$0x49, 0x10,
//$$$0x4A, 0x00,
//$$$0x4B, 0x00,
//$$$0x4C, 0x00,
//$$$0x4D, 0x44,
//$$$0x4E, 0x04,

0xE0, 0x00,	// // Disable Gamma			+++only here
0xE4, 0x21,	// // Dither				---need to recover

0xff, 0xff
};

